## sdkconfig.defaults
```kconfig
# Enable compiler optimizations for mining performance
# Use "Optimize for performance" instead of default "Debug" optimization
CONFIG_COMPILER_OPTIMIZATION_PERF=y

# Note: Hardware SHA acceleration is automatically used via esp_sha() API
# No additional configuration needed - esp_sha() always uses hardware
```
